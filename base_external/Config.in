## base_external/Config.in
```kconfig
source "$BR2_EXTERNAL_tuanti1997qn_final_project_PATH/package/imu-reader/Config.in"
source "$BR2_EXTERNAL_tuanti1997qn_final_project_PATH/package/AHRS/Config.in"
```

## base_external/package/AHRS/Config.in
```kconfig
config BR2_PACKAGE_IMU_READER_USER
	bool "imu-reader-user"
	help
	  Include imu reader software 
```

## base_external/package/imu-reader/Config.in
```kconfig
config BR2_PACKAGE_IMU_READER
	bool "imu-reader"
	help
	  Include imu reader kernel driver
```
